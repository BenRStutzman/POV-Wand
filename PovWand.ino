#include <avr/pgmspace.h>

const byte A = 0;
const byte B = 1;
const byte C = 2;
const byte D = 3;
const byte E = 4;
const byte F = 5;
const byte G = 6;
const byte H = 7;
const byte I = 8;
const byte J = 9;
const byte K = 10;
const byte L = 11;
const byte M = 12;
const byte N = 13;
const byte O = 14;
const byte P = 15;
const byte Q = 16;
const byte R = 17;
const byte S = 18;
const byte T = 19;
const byte U = 20;
const byte V = 21;
const byte W = 22;
const byte X = 23;
const byte Y = 24;
const byte Z = 25;
const byte _ = 26;
const byte apostrophe = 27;
const byte exclamation = 28;
const byte question = 29;
const byte comma = 30;

const byte numChars = 13;                                                     /* Insert the number of characters in your message.                       */
const byte message[numChars] = {H,A,P,P,Y,_,S,P,R,I,N,G,exclamation};            /* Type your message, with commas between the characters.                 */
const byte quickness = 100;                                                   /* Insert how fast you want your message to show, on a scale of 1 to 100. */

byte charNum = 1;
byte LEDnum = 1;
int flashNum = 0;
const byte alphaSize = 31;
const byte flashLength = 100/quickness;
const int numLEDs = 11;
const int charWidth = 6;
const int spaceWidth = 2;
const byte alphabet[numLEDs][charWidth*alphaSize] PROGMEM = {
  {0,1,1,1,1,0,   1,1,1,1,1,0,   0,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0,0},
  {1,0,0,0,0,1,   1,0,0,0,0,1,   0,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0,0},
  {1,0,0,0,0,1,   1,0,0,0,0,1,   1,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0,0},
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  {1,0,0,0,0,1,   1,1,1,1,1,0,   0,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0,0},
};
  
void setup() {
  for (LEDnum = 0; LEDnum <= numLEDs-1; LEDnum++){
    pinMode(LEDnum,OUTPUT);
  }
}

void loop() {
  for(charNum = 1; charNum <= numChars; charNum++){
    for(flashNum = message[charNum-1]*(charWidth); flashNum < (message[charNum-1]+1)*(charWidth); flashNum++){
      for(LEDnum = 0; LEDnum <= numLEDs-1; LEDnum++){
        digitalWrite(LEDnum,pgm_read_byte(&(alphabet[numLEDs-1-LEDnum][flashNum]))); //How to read from progmem found at http://forum.arduino.cc/index.php?topic=45681.0
      }
      delay(flashLength);
    }
    for (LEDnum = 0; LEDnum <= numLEDs-1; LEDnum++){
      digitalWrite(LEDnum,0);
    }
    delay(spaceWidth*flashLength);
  }
  for (LEDnum = 0; LEDnum <= numLEDs-1; LEDnum++){
      digitalWrite(LEDnum,0);
  }
  if((charWidth+spaceWidth)*numChars*flashLength < 350){
    delay(350-(charWidth+spaceWidth)*numChars*flashLength);
  }
  for(charNum = numChars; charNum >= 1; charNum--){
    for(flashNum = (message[charNum-1]+1)*(charWidth)-1; flashNum >= (message[charNum-1])*(charWidth); flashNum--){
      for(LEDnum = 0; LEDnum <= numLEDs-1; LEDnum++){
        digitalWrite(LEDnum,pgm_read_byte(&(alphabet[numLEDs-1-LEDnum][flashNum]))); //How to read from progmem found at http://forum.arduino.cc/index.php?topic=45681.0
      }
      delay(flashLength);
    }
    for (LEDnum = 0; LEDnum <= numLEDs-1; LEDnum++){
      digitalWrite(LEDnum,0);
    }
    delay(spaceWidth*flashLength);
  }
  for (LEDnum = 0; LEDnum <= numLEDs-1; LEDnum++){
      digitalWrite(LEDnum,0);
  }
  if((charWidth+spaceWidth)*numChars*flashLength < 350){
    delay(350-(charWidth+spaceWidth)*numChars*flashLength);
  }
}
